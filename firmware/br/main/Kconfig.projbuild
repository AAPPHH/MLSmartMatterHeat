## firmware/br/main/Kconfig.projbuild
```kconfig
menu "BR Watchdog"

    config BR_WATCHDOG_TOKEN
        string "Shared secret for the X-Heatd-Token header"
        default ""
        help
            Empty means every watchdog write endpoint answers 401.
            Put the real value in sdkconfig.<variant>.local, never in the repo.

    config BR_WATCHDOG_MATTER
        bool "Armed path: minimal Matter CASE client on the border router"
        default y
        help
            Built-in Matter controller side client (CASE + Interaction Model write over lwIP UDP, mbedTLS).
            With this off the watchdog runs dry_run only and refuses mode armed.

    config BR_WATCHDOG_MATTER_RUST
        bool "Use the Rust Matter client (firmware/br/matter_client) instead of the C one"
        depends on BR_WATCHDOG_MATTER
        default y
        help
            Needs the esp Rust toolchain (espup) and cargo on PATH. The C client is a fallback only;
            the watchdog stays dry_run until on-device interop with the Rust client has passed.

    config BR_CONN_REBOOT_MINUTES
        int "Restart the WiFi station after this many minutes without an IP (0 = never)"
        range 0 1440
        default 15
        help
            Only the WiFi driver is restarted (disconnect and reconnect), OpenThread keeps running.
            The next restart waits 4x, then 24x this time (15 min, 1 h, 6 h by default) until the IP
            has been stable for 10 minutes. Skipped while a heartbeat arrived in the last 5 minutes.
            Values 1..10 are raised to 11.

endmenu
```
